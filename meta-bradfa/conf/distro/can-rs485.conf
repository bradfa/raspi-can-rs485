## meta-bradfa/conf/distro/can-rs485.conf
```bitbake
DISTRO = "can-rs485"
DISTRO_NAME = "can-rs485"
DISTRO_VERSION = "1.0+snapshot-${METADATA_REVISION}"
DISTRO_CODENAME = "scarthgap"

DISTRO_FEATURES = " \
    ext2 \
    ipv4 \
    ipv6 \
    minidebuginfo \
    systemd \
    usrmerge \
    vfat \
    zeroconf \
"

# Use systemd for init
INIT_MANAGER = "systemd"
VIRTUAL-RUNTIME_initscripts = ""
VIRTUAL-RUNTIME_syslog = ""
VIRTUAL-RUNTIME_sysklogd = ""
VIRTUAL-RUNTIME_base-utils-syslog = ""

# Allow for using recipes under the Synaptics license, like some Raspi firmware
LICENSE_FLAGS_ACCEPTED += "synaptics-killswitch"
```
